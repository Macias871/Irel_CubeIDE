#include "BUS.h"
#include <string.h>
#include "main.h"
#include "cmsis_os.h"
#include "globals.h"

xSemaphoreHandle refresh_data_mutex;
xQueueHandle xEthParamsQueue;
xQueueHandle uart_rx_data_queue;
xQueueHandle xDebugQueueHandle;
xTaskHandle xBusTaskHandle;
xTaskHandle xEthTaskHandle = NULL;
uint8_t PWMy[2];
char PWM1[5];
char PWM2[5];


volatile SlaveModule S[7];
#ifdef PWMSlave
volatile SlavePWMModule SPWM[7];
#endif
volatile uint8_t dey_chg_f;
volatile prgWeek P[3];
volatile structAlarm alarmItem[ALARMSH_SIZE];
volatile _ethParam ethParam;
volatile eth_to_log_t eth_to_log;
volatile uint32_t gui_refresh_bits_0 = 0x00000000;
volatile uint32_t gui_refresh_bits_1 = 0x00000000;
volatile uint32_t updateBits0 = 0x00000000;

_temperatures Temperatures;

volatile int8_t global_temperature_tab[5];
volatile int8_t global_room_temp_down;
volatile int8_t tmp_room_temp_down;
volatile uint8_t global_room_temp_ordered;
volatile uint8_t global_cwu_temp_cwu_on[] = { 0, 0, 0, 0, 0, 0};
volatile int8_t tmp_cwu_temp_cwu_on;
volatile uint8_t tmp_cwu_temp_cwu_off;
volatile uint8_t tmp_cwu_temp_readed;
volatile int8_t global_cwu_temp_offset_tab[] = { 0, 0, 0, 0, 0, 0};
volatile uint8_t global_prev_temperature_co=0;
volatile int16_t sys_integral_prv;
volatile uint8_t sys_room_temperature = 0;
//volatile uint16_t sys_inside_temperature = 0;
volatile uint8_t refresh_kg = 0;
volatile _datetime_struct global_time;
volatile uint8_t sp_have_to_set_flag = 0;
volatile uint8_t psg_on_delay = 10;	// opoznienie zalaczenia
volatile uint8_t spr_on_cnt_local[] = { 0, 0, 0, 0, 0, 0};
volatile uint8_t pdz_off_cnt_local[] = { 0, 0, 0, 0, 0, 0};
volatile uint8_t kg_mul=3;
volatile int16_t sys_integral = 0;
volatile uint8_t integral_delay = 0;
volatile uint8_t integral_spring = 0;
volatile uint32_t integral_set_counter = 0;
volatile long long_integral = 0;
volatile int16_t delta_temp = 0; // delta T1 i T wyliczonej z KG
volatile int16_t delta_time = 0;
volatile uint8_t sys_integral_time = 60;
volatile uint8_t integral_period_time=60;
volatile uint8_t integral_period_counter=0;
volatile int16_t integral_levels[] = {-60, -120, -150, -180, -210, -250, -300, -500, -600, -900};
volatile int8_t heating_on_temperature = 16;
volatile int8_t heating_off_temperature = 18;
volatile uint16_t cwuTime = 600;
volatile uint16_t cntCwu = 600;
volatile uint16_t coTime = 1200;
volatile uint16_t cntCo = 1200;
volatile uint16_t integral_delay_time=120;
/* legionella */
volatile uint16_t legionellaCnt = 0;
volatile uint8_t legionellaFlags = 0;
volatile uint8_t legionellaDay = 5;
volatile uint8_t legionellaHour = 1;
volatile uint8_t legionella_down_counter = 5;
volatile uint8_t prvTimeToLegionella = 0;
volatile uint8_t legionella_interval = 7;
volatile uint8_t legTime = 4;

volatile uint8_t sys_time_hour = 1;
volatile uint8_t sys_time_minute = 0;
volatile uint8_t sys_date_day = 1;
volatile uint8_t sys_date_month = 2;
volatile uint8_t sys_date_year = 11;

/* czas bezczynnosci */
volatile uint16_t system_idle_counter = 0;

/* alarmy */
volatile uint8_t alarmFirst=0;

/* temperatury */
volatile uint8_t sysMaxTemp = 80;
volatile uint8_t sysMinTemp = 3;
volatile uint8_t sysLegTemp = 60;
volatile int8_t sysMaxDZ = 0;
volatile int8_t sysMinDZ = 0;
volatile uint8_t delta_CWU = 0;



/* urlop */
volatile uint8_t urlop_days_number = 5;
volatile uint8_t urlop_co_temp = 20;
volatile uint8_t urlop_cwu_temp = 50;
volatile uint8_t urlop_is_cwu=0;
volatile uint8_t urlop_enable_down_counter=6;

/* wygrzewanie */
volatile uint8_t annealing[5];
volatile uint8_t overheating_down_counter=5;
volatile uint8_t prvAnnealingCnt=5;

volatile uint8_t cntBreakPer=0;

volatile uint16_t gui_idle_time = 1800;
volatile uint16_t gui_idle_counter = 0;
volatile uint16_t tft_flash_counter = 0;
volatile uint8_t markedDay = 0x00;
volatile uint8_t markedPr = 0x00;
volatile uint8_t prgType = 0;
volatile uint8_t prgWeekDayIndex = 0x00;
volatile uint8_t prgLevelIndex = 0x00;
volatile uint8_t prgPrevHourToChange = 0;
volatile uint8_t prgHourToChange = 0;
volatile int8_t prgMinuteToChange = 0;
volatile uint8_t prgNextHourToChange = 0;
volatile uint8_t prgTempToChange = 0;
volatile uint8_t serviceError = 0;
volatile uint8_t sys_cwu_mode = 0;
volatile uint8_t circulation_enabled = 0;
volatile uint8_t circCwuTemp = 18;
volatile uint8_t circCwuTimeOn = 10;
volatile uint8_t circCwuTimeOff = 50;
volatile uint8_t tmpTabU8[10];
volatile int8_t tmpTab8[10];
volatile uint16_t tmpTabU16[10];
volatile int16_t tmpTab16[10];
volatile uint8_t backlightInt = 0;
volatile uint8_t startCnt = 20;
const int16_t TempTab080[] = {
    800,800,800,800,800,800,800,800,800,800,800,800,800,800,800,800,800,800,800,800,800,800,800,800,800,800,800,800,800,800,800,800,
    800,800,800,800,800,800,800,800,800,800,800,800,800,800,800,800,800,800,800,800,800,800,800,800,800,800,800,800,800,800,800,800,
    800,800,800,800,800,800,800,800,800,800,800,800,800,800,800,800,800,800,800,800,800,800,800,800,800,800,800,800,800,800,800,800,
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    0,0,0,0,0,0,0,0,0,0,0,0,0,0,0,0,0,0,0,0,0,0,0,0,0,0,0,0,0,0,0,0
};
const int16_t TempTabm2030[] = {
    300,300,300,300,300,300,300,300,300,300,300,300,300,300,300,300,300,300,300,300,300,300,300,300,300,300,300,300,300,300,300,300,
    300,300,300,300,300,300,300,300,300,300,300,300,300,300,300,300,300,300,300,300,300,300,300,300,300,300,300,300,300,300,300,300,
    300,300,300,300,300,300,300,300,300,300,300,300,300,300,300,300,300,300,300,300,300,300,300,300,300,300,300,300,300,300,300,300,
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    -200,-200,-200,-200,-200,-200,-200,-200,-200,-200,-200,-200,-200,-200,-200,-200,-200,-200,-200,-200,-200,-200,-200,-200,-200,-200,-200,-200,-200,-200,-200,-200
};
const int16_t TempTabm4060[]={
    600,600,600,600,600,600,600,599,599,599,599,599,599,599,599,599,599,599,599,599,599,599,599,598,598,598,598,598,598,598,598,598,
    598,598,598,598,598,598,597,597,597,597,597,597,597,597,597,597,597,597,597,597,597,596,596,596,596,596,596,596,596,596,596,596,
    596,596,596,596,596,595,595,595,595,595,595,595,595,595,595,595,595,595,595,595,594,594,594,594,594,594,594,594,594,594,594,594,
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    -367,-367,-367,-368,-368,-368,-368,-368,-368,-368,-368,-368,-368,-368,-369,-369,-369,-369,-369,-369,-369,-369,-369,-369,-369,-370,-370,-370,-370,-370,-370,-380
};
volatile uint8_t system_log_ready = 0;
volatile uint8_t kgOffset[10] = { 4, 6, 8, 10, 12, 14, 16, 18, 20, 22};
volatile int16_t kgPrvArray[12] = { 0,0,0,0,0,0,0,0,0,0,0,0 };
volatile int8_t kgAngle = 0;
volatile uint8_t circEn = 0;
volatile uint16_t prvScreenNumber = 0;
volatile uint16_t tmpScreenNumber = 0;
volatile uint8_t act_page = 10;
volatile uint8_t overheating_enable_flag = 0;
volatile uint8_t urlop_enable_flag = 0;
volatile uint8_t system_state = 0x00;
volatile uint16_t integral_flags = 0x0000;
volatile int16_t temp_result[] = {
    0,0,0,0,0,0,0,0
};
volatile volatile uint8_t sys_enabled_slaves = 1;
volatile uint8_t PWM_enable = 1;
volatile uint8_t PWM_optym_en = 0;
volatile uint8_t PWM_optym_page = 0;
volatile uint8_t PWM_vc_pdz = 90;
volatile uint8_t PWM_vc_pco = 80;
volatile uint8_t PWM_i_co = 2;
volatile uint8_t PWM_i_cwu = 2;
volatile uint8_t PWM_i_pdz = 5;
volatile uint8_t PWM_vs_pco = 80;
volatile uint8_t PWM_vs_pdz = 90;
volatile uint8_t PWM_rt_co = 7;
volatile uint8_t PWM_rt_dz = 3;
volatile uint8_t PWM_vj_pco = 30;
volatile uint8_t PWM_cs_pco = 3;
volatile uint8_t PWM_ws_pco = 30;
volatile uint8_t sys_room_t_sensor_cfg = 0;
volatile uint8_t tft_reinitialize_flag = 0;
volatile uint16_t tft_reinitialize_counter = 0;
volatile uint8_t system_wait_flag = 0;
volatile int8_t act_state = 2;
volatile uint8_t event_register_length = 25;
volatile uint8_t event_register_start_address = 0;
volatile uint8_t log_lock = 0;
volatile uint8_t act_view = 0;
volatile uint16_t display_orientation = 270;  // bylo 90
volatile uint32_t battery_voltage = 0;
char debMsg[200];
volatile uint8_t tpIdleTime = 0;
volatile uint8_t delayCnt = 100;
volatile uint8_t alarmsLenght = 25;
volatile uint8_t alarmsStart = 0;
volatile uint8_t gvar_is_connected = 0U;
volatile uint8_t gvar_get_ping = 0U;
uint8_t sys_language = 1;
uint8_t DHCP_refresh = 0;

int8_t basic_hc_default_wall[] = {
   21, 21, 24, 31, 36, 40, 44, 48, 53, 57, 61, 65
};
int8_t basic_hc_default_floor[] = {
   10, 10, 21, 26, 30, 32, 35, 37, 39, 42, 44 ,48
};
int8_t basic_hc[] = {
   10, 10, 12, 18, 28, 36, 44, 47, 52, 54, 56, 58
};
int8_t tmp_offset_hc[] = {
   0, 0, 0, 0, 0, 0, 0, 0, 0, 0, 0, 0
};
int8_t offset_hc[] = {
   0, 0, 0, 0, 0, 0, 0, 0, 0, 0, 0, 0
};
int8_t tmp_user_hc[] = {
   0, 0, 0, 0, 0, 0, 0, 0, 0, 0, 0, 0
};
int8_t user_hc[] = {
   0, 0, 0, 0, 0, 0, 0, 0, 0, 0, 0, 0
};
int8_t system_hc[] = {
   25, 25, 25, 29, 34, 40, 43, 45, 47, 49, 51, 53
};
int8_t tmp_system_hc[] = {
   25, 25, 25, 29, 34, 40, 43, 45, 47, 49, 51, 53
};
int8_t program_hc[] = {
   30, 30, 30, 34, 39, 45, 48, 50, 52, 54, 56, 58
};
int8_t program_full_hc[60];
int8_t hc_actual_possition = 0;
int8_t tmp_hc_actual_possition = 0;






int16_t ADCPT1000_to_temp(uint16_t adc) {
    int32_t temp;
    if ( adc < 1293) {
      temp = ((int32_t)(adc - 1162) * 100) / 131;
    }
    else {
        if (adc < 1662) {
          temp = (((int32_t)(adc - 1293) * 100) / 123) + 100;
        }
        else {
            if (adc < 2018) {
              temp = (((int32_t)(adc - 1662) * 100) / 119) + 401;
            }
            else {
               temp = (((int32_t)(adc - 2018) * 100) / 119) + 700;
            }
        }
    }
    return (int16_t)temp;
}

int16_t ADCPT1000_to_temp_old2(uint16_t adc) { // do lipca 2020r.
    int32_t temp;
    if ( adc < 1318) {
      temp = ((int32_t)(adc - 1158) * 100) / 160;
    }
    else {
        if (adc < 1698) {
          temp = (((int32_t)(adc - 1318) * 100) / 127) + 100;
        }
        else {
            if (adc < 2035) {
              temp = (((int32_t)(adc - 1698) * 100) / 112) + 400;
            }
            else {
               temp = (((int32_t)(adc - 2035) * 100) / 112) + 700;
            }
        }
    }
    return (int16_t)temp;
}

int16_t ADCPT1000_to_temp_old1(uint16_t adc) {
    int32_t temp;
    if ( adc < 865) {
      temp = ((int32_t)(adc - 670) * 100) / 199;
    }
    else {
        if (adc < 1425) {
          temp = (((int32_t)(adc - 865) * 100) / 199) + 100;
        }
        else {
            if (adc < 1950) {
              temp = (((int32_t)(adc - 1425) * 100) / 186) + 400;
            }
            else {
               temp = (((int32_t)(adc - 1950) * 100) / 176) + 700;
            }
        }
    }
    return (int16_t)temp;
}
int16_t ADCNTCZ_to_temp(uint16_t adc) {
    int32_t temp;
    if ( adc < 298) {    // 25  st.
      temp = (((int32_t)(165 - adc) * 150) / 133) + 400;
    }
    else {
        if (adc < 377) {  // 15 st.
          temp = (((int32_t)(298 - adc) * 100) / 79) + 250;
        }
        else {
            if (adc < 502) { // 10 st.
              temp = (((int32_t)(377 - adc) * 50) / 125) + 150;
            }
            else {
              if (adc < 605) { // 5 st.
                temp = (((int32_t)(502 - adc) * 50) / 103) + 100;
              }
              else {
                if (adc < 737) { // 0 st.
                  temp = (((int32_t)(605 - adc) * 50) / 132) + 50;
                }
                else {
                  if (adc < 888) { // -5 st.
                    temp = (((int32_t)(737 - adc) * 50) / 151);
                  }
                  else {
                    if (adc < 1090) { // -10 st.
                      temp = (((int32_t)(888 - adc) * 50) / 202) - 50;
                    }
                    else {
                      if (adc < 1278) { // -15 st.
                        temp = (((int32_t)(1090 - adc) * 50) / 188) - 100;
                      }
                      else {
                        if (adc < 1520) { // -20 st.
                          temp = (((int32_t)(1278 - adc) * 50) / 242) - 150;
                        }
                        else {
                          if (adc < 1792) { // -25 st.
                            temp = (((int32_t)(1520 - adc) * 50) / 200) - 200;
                          }
                          else {
                            if (adc < 2091) { // -30 st.
                              temp = (((int32_t)(1792 - adc) * 50) / 299) - 250;
                            }
                            else {
                              temp = (((int32_t)(2091 - adc) * 50) / 299) - 300;
                            }
                          }
                        }
                      }
                    }
                  }
                }
              }
            }
        }
    }
    return (int16_t)temp;
}




void out_do_1_set(void){
    if(S[0].Out.DO1 == 0){
S[0].DigitalOutputs |= (1<<2);

            SET_TO_UPDATE_ODO1();

    }
}
void out_do_1_clr(void){
    if(S[0].Out.DO1 == 1){
        S[0].DigitalOutputs &=~ (1<<2);

        SET_TO_UPDATE_ODO1();
    }
}
void out_do_2_set(void){
    if(S[0].Out.DO2 == 0){
S[0].DigitalOutputs |= (1<<1);

            SET_TO_UPDATE_ODO2();

    }
}
void out_do_2_clr(void){
    if(S[0].Out.DO2 == 1){
        S[0].DigitalOutputs &=~ (1<<1);

        SET_TO_UPDATE_ODO2();
    }
}
void out_zzc_set(void){
    if(S[0].Out.ZZC == 0){


                S[0].DigitalOutputs |= (1<<0);



    }
}
void out_zzc_clr(void){
    if(S[0].Out.ZZC == 1){
        S[0].DigitalOutputs &=~ (1<<0);

    }
}
void out_p_cwu_set(void){
    if(S[0].Out.PCWU == 0){
        S[0].DigitalOutputs |= (1<<4);

    }
}
void out_p_cwu_clr(void){
    if(S[0].Out.PCWU == 1){
        S[0].DigitalOutputs &=~ (1<<4);

    }
}
void out_sp_clr(uint8_t module) {
    if(S[module].Out.SP == 1){
        S[module].Out.SP = 0;

    }
    sp_have_to_set_flag = 0;
}
uint8_t out_sp_set(uint8_t module) {
    if(S[module].Out.SP == 0){
        //if(!(serviceErrorChk())){
        if ((S[module].T[4] > sysMinDZ) && (S[module].T[4] < sysMaxDZ)) {
            if(S[module].In.PWC == 0){
                if(S[module].In.PNC == 0){
                    if(S[module].In.WS == 0){
                        if(S[module].In.ZZ == 0){
                            if(cntBreakPer==0){


                                            S[module].Out.SP = 1;
                                            logs_add_event(EVENT_SP_ON, module);
                                            if (S[module].Out.PSG == 0) out_p_sg_set(module);
                                            if (S[module].Out.PDZ == 0) out_p_dz_set(module);
                                            SET_TO_UPDATE_OSP();
                                            return 0;



                            }
                        }
                    }
                }
            }
            //}
        }
        ///prdSpr = 1;
    }
    return 1;
}
void out_p_dz_set(uint8_t module) {
    if(S[module].Out.PDZ == 0){


                S[module].Out.PDZ = 1;
                logs_add_event(EVENT_PDZ_ON, module);
                SET_TO_UPDATE_ODZ();


    }
}
void out_p_dz_clr(uint8_t module) {
    if(S[module].Out.PDZ == 1){
        S[module].Out.PDZ = 0;
        logs_add_event(EVENT_PDZ_OFF, module);
        SET_TO_UPDATE_ODZ();
    }
}
void out_p_sg_set(uint8_t module) {
    if(S[module].Out.PSG == 0){

            S[module].Out.PSG = 1;
            logs_add_event(EVENT_PSG_ON, module);
            SET_TO_UPDATE_OSG();

    }
}
void out_p_sg_clr(uint8_t module) {
    if(S[module].Out.PSG == 1){
        S[module].Out.PSG = 0;
        logs_add_event(EVENT_PSG_OFF, module);
        SET_TO_UPDATE_OSG();
    }
}
void out_z3d_set(uint8_t module) {
    if(S[module].Out.Z3D == 0){
        S[module].Out.Z3D = 1;
        logs_add_event(EVENT_Z3D_CWU, module);
        SET_TO_UPDATE_OZ3D();
    }
}
void out_z3d_clr(uint8_t module) {
    if(S[module].Out.Z3D == 1){
        S[module].Out.Z3D = 0;
        logs_add_event(EVENT_Z3D_CO, module);
        SET_TO_UPDATE_OZ3D();
    }
}


void temp_to_xchar_3(int16_t integer, XCHAR *result, uint8_t startIndex){
    //uint8_t pos=0;
    if(integer < -999) integer = -999;
    if(integer > 999) integer = 999;
    if(integer < 0){
            result[startIndex]='-';
            integer*=-1;
    }
    else result[startIndex]=' ';
    startIndex++;
    int8_t num1 = integer/100;
    int8_t num2 = (integer%100)/10;
    int8_t num3 = integer%10;
    result[startIndex+0]=(XCHAR)(num1+0x30);
    result[startIndex+1]=(XCHAR)(num2+0x30);
    result[startIndex+2]='.';
    result[startIndex+3]=(XCHAR)(num3+0x30);
    return;
}

